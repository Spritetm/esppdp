## firmware/main/Kconfig.projbuild
```kconfig
menu "ESP-PDP11 Configuration"

    choice ESPPDP_HARDWARE
        prompt "Hardware to run on"
        default ESPPDP_HW_WROVER_KIT
        help
            Target hardware selection

        config ESPPDP_HW_WROVER_KIT
            bool "Esp32-Wrover-Kit development board"
        config ESPPDP_HW_FINAL
            bool "Final dedicated board"
        config ESPPDP_HW_2432S028
            bool "Sunton 2432S028 board"
    endchoice


endmenu
```
